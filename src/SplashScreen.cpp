#include "SplashScreen.h"
#include <TFT_eSPI.h>
#include "PepeDraw.h"
#include "Pins.h"
#include "SoundUtils.h"
#include "NVSStore.h"

extern TFT_eSPI tft;

// ═══════════════════════════════════════════════════════════════════════════
//  BITMAP DEL AJOLOTE CON LENTES · 96x80 píxeles monochrome
//  · 80 filas × 12 bytes = 960 bytes
//  · Mascota oficial del firmware
// ═══════════════════════════════════════════════════════════════════════════
#define AJOLOTE_WIDTH   96
#define AJOLOTE_HEIGHT  80
#define AJOLOTE_BYTES   960

static const uint8_t AJOLOTE_BMP[AJOLOTE_BYTES] PROGMEM = {
    0x00, 0x00, 0x00, 0x00, 0x00, 0x00, 0x00, 0x00, 0x00, 0x00, 0x00, 0x00,
    0x00, 0x00, 0x00, 0x00, 0x00, 0x00, 0x00, 0x00, 0x00, 0x00, 0x00, 0x00,
    0x00, 0x00, 0x00, 0x00, 0x00, 0x00, 0x00, 0x00, 0x00, 0x00, 0x00, 0x00,
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    0x00, 0x00, 0x00, 0x00, 0x00, 0x00, 0x00, 0x00, 0x00, 0x00, 0x00, 0x00,
};

// ═══════════════════════════════════════════════════════════════════════════
//  HELPERS DE DIBUJO
// ═══════════════════════════════════════════════════════════════════════════
static void drawAjoloteRow(int x0, int y0, int row, uint16_t color) {
    int bytesPerRow = AJOLOTE_WIDTH / 8;
    for (int byteIdx = 0; byteIdx < bytesPerRow; byteIdx++) {
        uint8_t bits = pgm_read_byte(
            &AJOLOTE_BMP[row * bytesPerRow + byteIdx]);
        if (bits == 0) continue;
        for (int bit = 0; bit < 8; bit++) {
            if (bits & (0x80 >> bit)) {
                tft.drawPixel(x0 + byteIdx * 8 + bit, y0 + row, color);
            }
        }
    }
}

static void drawAjoloteFull(int x0, int y0, uint16_t color) {
    for (int r = 0; r < AJOLOTE_HEIGHT; r++) {
        drawAjoloteRow(x0, y0, r, color);
    }
}

// ═══════════════════════════════════════════════════════════════════════════
//  ANIMACIÓN SCAN-IN
// ═══════════════════════════════════════════════════════════════════════════
static void animateScanIn(int x0, int y0) {
    const int SCAN_LINE_HEIGHT = 2;
    for (int r = 0; r < AJOLOTE_HEIGHT; r++) {
        drawAjoloteRow(x0, y0, r, UI_MAIN);
        int scanY = y0 + r + SCAN_LINE_HEIGHT;
        if (scanY < y0 + AJOLOTE_HEIGHT) {
            tft.drawFastHLine(x0, scanY, AJOLOTE_WIDTH, UI_SELECT);
        }
        delay(7);
        if (scanY < y0 + AJOLOTE_HEIGHT) {
            tft.drawFastHLine(x0, scanY, AJOLOTE_WIDTH, TFT_BLACK);
        }
    }
}

// ═══════════════════════════════════════════════════════════════════════════
//  ANIMACIÓN TYPE-ON
// ═══════════════════════════════════════════════════════════════════════════
static void typeOn(int x, int y, const String& txt, uint16_t color,
                   int size, FontType font, int msPerChar) {
    String partial = "";
    for (int i = 0; i < (int)txt.length(); i++) {
        partial += txt[i];
        if (font == FONT_BIG) {
            tft.fillRect(x, y, 320 - x, 12 * size, TFT_BLACK);
            drawStringBig(x, y, partial, color, size);
        } else {
            tft.fillRect(x, y, 320 - x, 7 * size, TFT_BLACK);
            drawStringCustom(x, y, partial, color, size);
        }
        delay(msPerChar);
    }
}

// ═══════════════════════════════════════════════════════════════════════════
//  LOADING STEP
// ═══════════════════════════════════════════════════════════════════════════
static void drawLoadingStep(const String& stepText, int progress,
                            uint16_t toneFreq) {
    int statusY = 175;
    tft.fillRect(10, statusY, 300, 10, TFT_BLACK);
    drawStringCustom(10, statusY, stepText, UI_ACCENT, 1);

    int barX = 10, barY = 190, barW = 300, barH = 8;
    tft.drawRect(barX, barY, barW, barH, UI_ACCENT);

    int fillW = (barW - 2) * progress / 100;
    tft.fillRect(barX + 1, barY + 1, barW - 2, barH - 2, TFT_BLACK);
    if (fillW > 0) {
        tft.fillRect(barX + 1, barY + 1, fillW, barH - 2, UI_MAIN);
    }
    beep(toneFreq, 40);
}

// ═══════════════════════════════════════════════════════════════════════════
//  MAIN · SPLASH SCREEN
// ═══════════════════════════════════════════════════════════════════════════
void runSplashScreen() {
    tft.fillScreen(TFT_BLACK);
    tft.drawRect(0, 0, 320, 240, UI_MAIN);

    // FASE 1: Scan-in del ajolote
    int ajoX = (320 - AJOLOTE_WIDTH) / 2;
    int ajoY = 15;
    animateScanIn(ajoX, ajoY);

    delay(200);

    // FASE 2: Textos type-on
    {
        String title = "ESP32-TOOLS";
        int titleW   = getTextWidth(title, 2, FONT_BIG);
        int titleX   = (320 - titleW) / 2;
        int titleY   = 105;
        typeOn(titleX, titleY, title, UI_MAIN, 2, FONT_BIG, 55);
    }
    delay(150);
    {
        String author = "BY: PepeAngell";
        int authW     = getTextWidth(author, 2, FONT_SMALL);
        int authX     = (320 - authW) / 2;
        int authY     = 140;
        typeOn(authX, authY, author, UI_ACCENT, 2, FONT_SMALL, 40);
    }
    delay(250);

    // FASE 3: Loading steps
    drawLoadingStep("Initializing NVS...",      25,  1200);
    delay(180);
    drawLoadingStep("Loading preferences...",   50,  1600);
    delay(180);
    drawLoadingStep("Mounting display...",      75,  2000);
    delay(180);
    drawLoadingStep("Ready.",                  100,  2600);
    delay(300);

    // FASE 4: Boot count + esperar OK
    unsigned long bootCount = nvsGetULong("boot_cnt", 0);
    String bootInfo = "Boot #" + String(bootCount);
    drawStringCustom(10, 215, bootInfo, UI_ACCENT, 1);

    String pressText = "PRESS OK TO CONTINUE";
    int pressW = getTextWidth(pressText, 1);
    int pressX = 310 - pressW;
    int pressY = 215;

    bool blinkOn = true;
    unsigned long lastBlink = millis();
    unsigned long blinkInterval = 450;

    beep(2400, 60);
    delay(40);
    beep(3000, 80);

    while (digitalRead(BTN_OK) == HIGH) {
        if (millis() - lastBlink > blinkInterval) {
            blinkOn = !blinkOn;
            tft.fillRect(pressX, pressY, pressW + 4, 8, TFT_BLACK);
            if (blinkOn) {
                drawStringCustom(pressX, pressY, pressText, UI_SELECT, 1);
            }
            lastBlink = millis();
        }
        delay(20);
    }

    beep(2200, 50);
    delay(30);
    beep(2800, 50);
    delay(30);
    beep(3200, 80);

    while (digitalRead(BTN_OK) == LOW) delay(5);
    delay(100);
}